## conf/layer.conf
```bitbake
# We have a conf and classes directory, add to BBPATH
BBPATH := "${BBPATH}:${LAYERDIR}"

# We have a recipes directory, add to BBFILES
BBFILES := "\
    ${BBFILES} ${LAYERDIR}/recipes-*/*/*.bb \
    ${LAYERDIR}/recipes-*/*/*.bbappend \
"

BBFILE_COLLECTIONS += "iot-cloud"
BBFILE_PATTERN_iot-cloud:= "^${LAYERDIR}/"
BBFILE_PRIORITY_iot-cloud = "10"
LAYERSERIES_COMPAT_iot-cloud = "warrior zeus"
LAYERDEPENDS_iot-cloud = "\
    core \
    openembedded-layer \
    meta-python \
    networking-layer \
"
```
